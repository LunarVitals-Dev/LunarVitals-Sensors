## pulse_HR/build/victor_pulse_HR/Kconfig/boards/Kconfig.defconfig
```kconfig
# Load Zephyr board defconfig descriptions.
osource "/opt/nordic/ncs/v2.8.0/zephyr/boards/nordic/nrf52840dk/Kconfig.defconfig"
```

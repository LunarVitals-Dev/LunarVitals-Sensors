## CMakeLists.txt
```
cmake_minimum_required(VERSION 3.20.0)
find_package(Zephyr REQUIRED HINTS $ENV{ZEPHYR_BASE})

project(MPU6050)

target_sources(app PRIVATE src/main.c)
target_sources(app PRIVATE src/i2c.c)
target_sources(app PRIVATE src/BMP280.c)
target_sources(app PRIVATE src/MLX90614.c)
target_sources(app PRIVATE src/MPU6050.c)
```

## prj.conf
```kconfig
CONFIG_I2C=y
CONFIG_I2C_NRFX=y
CONFIG_SERIAL=y
CONFIG_PRINTK=y
CONFIG_GPIO=y
CONFIG_UART_CONSOLE=y
CONFIG_ADC=y
CONFIG_ADC_NRFX_SAADC=y
CONFIG_PRINTK=y
CONFIG_CBPRINTF_FP_SUPPORT=y
CONFIG_SHELL=y
CONFIG_I2C_SHELL=y
```

## src/main.c
```c
#include <zephyr/device.h>
#include <zephyr/drivers/i2c.h>
#include <zephyr/sys/printk.h>
#include <zephyr/kernel.h>
#include <stdint.h>
#include <stdio.h>
#include <stdlib.h>

#include "MPU6050.h"
#include "MLX90614.h"
#include "BMP280.h"
#include "i2c.h"


int main(void) {
    i2c_init();
    while (1) {
        i2c_read_data();

        k_msleep(1000);  
    }
    return 0;
}
```

## src/BMP280.h
```c
#ifndef BMP280_H
#define BMP280_H

#include <zephyr/device.h>
#include <zephyr/drivers/i2c.h>
#include <zephyr/sys/printk.h>
#include <zephyr/kernel.h>
#include <stdint.h>

// HOW TO CONNECT: (BMP --> Nordic)
// SCK --> Pin 27
// SDI --> Pin 26
// SDO --> GND (for I2C Address 0x76)    *VDO --> VDD (makes I2C address 0x77)*
// CS --> VDD
// 3Vo --> VDD
// GND --> GND

#define BMP280_ADDR 0x76  // Adjust to 0x77 if SDO pin is high

// BMP280 Register Addresses
#define BMP280_REG_CALIB_START    0x88
#define BMP280_REG_CHIPID         0xD0
#define BMP280_REG_SOFTRESET      0xE0
#define BMP280_REG_CONTROL        0xF4
#define BMP280_REG_CONFIG         0xF5
#define BMP280_REG_PRESSURE_MSB   0xF7
#define BMP280_REG_TEMPERATURE_MSB 0xFA

// Calibration parameters
uint16_t dig_T1;
int16_t dig_T2, dig_T3;
uint16_t dig_P1;
int16_t dig_P2, dig_P3, dig_P4, dig_P5, dig_P6, dig_P7, dig_P8, dig_P9;
int32_t t_fine;

#endif
```

## src/LSM9DS1.h
```c
#ifndef LSM9DS1_H
#define LSM9DS1_H

#include <zephyr/device.h>
#include <zephyr/drivers/i2c.h>
#include <zephyr/sys/printk.h>
#include <zephyr/kernel.h>
#include <stdint.h>
#include <stdio.h>
#include <stdlib.h>

// LSM9DS1 Register Addresses
#define LSM9DS1_AG_ADDR 0x6B // I2C address of the LSM9DS1 Accelerometer/Gyroscope
#define LSM9DS1_M_ADDR  0x1E // I2C address of the magnetometer
#define WHO_AM_I_REG 0x0F // WHO_AM_I register address
#define CTRL_REG1_G  0x10 // Gyro control register 1
#define CTRL_REG6_XL 0x20 // Accelerometer control register 6
#define OUT_X_L_G  0x18 // Gyro X-axis output low byte
#define OUT_X_L_XL 0x28 // Accelerometer X-axis output low byte
#define OUT_X_L_M  0x28 // Magnetometer X-axis output low byte

#endif
```

## src/MLX90614.h
```c
#ifndef MLX90614_H
#define MLX90614_H

#include <zephyr/device.h>
#include <zephyr/drivers/i2c.h>
#include <zephyr/sys/printk.h>
#include <zephyr/kernel.h>
#include <stdint.h>
#include <stdio.h>
#include <stdlib.h>

// MLX90614 Registers
#define MLX90614_ADDR 0x5A // Default I2C address of MLX90614
#define MLX90614_TA 0x06 // Ambient temperature register
#define MLX90614_TOBJ1 0x07 // Object 1 temperature register

#endif
```

## src/MPU6050.h
```c
#ifndef MPU6050_H
#define MPU6050_H

#include <zephyr/device.h>
#include <zephyr/drivers/i2c.h>
#include <zephyr/sys/printk.h>
#include <zephyr/kernel.h>
#include <stdint.h>
#include <stdio.h>
#include <stdlib.h>

// MPU6050 Registers
#define MPU6050_ADDR 0x68          // Default I2C address of MPU6050
#define DEVICE_ID 0x75
#define PWR_MGMT_1   0x6B
#define ACCEL_XOUT_H 0x3B
#define GYRO_XOUT_H  0x43

#endif
```

## src/i2c.c
```c
#include "i2c.h"
#include "BMP280.h"
#include "MPU6050.h"
#include "MLX90614.h"
#include <zephyr/device.h>
#include <zephyr/drivers/i2c.h>
#include <zephyr/sys/printk.h>
#include <zephyr/kernel.h>

const struct device *i2c_dev0 = DEVICE_DT_GET(DT_NODELABEL(i2c0));
const struct device *i2c_dev1 = DEVICE_DT_GET(DT_NODELABEL(i2c1));

int i2c_write_register(const struct device *i2c_dev, uint8_t dev_addr, uint8_t reg_addr, uint8_t data) {
    uint8_t buffer[2] = {reg_addr, data};
    return i2c_write(i2c_dev, buffer, sizeof(buffer), dev_addr);
}

int i2c_read_register(const struct device *i2c_dev, uint8_t dev_addr, uint8_t reg_addr, uint8_t *data) {
    return i2c_write_read(i2c_dev, dev_addr, &reg_addr, 1, data, 1);
}

int i2c_read_registers(const struct device *i2c_dev, uint8_t dev_addr, uint8_t reg_addr, uint8_t *data, size_t len) {
    return i2c_write_read(i2c_dev, dev_addr, &reg_addr, 1, data, len);
}

void i2c_init(void) {
    if (!device_is_ready(i2c_dev0)) {
        printk("I2C0 device not ready\n");
        return;
    }

    if (!device_is_ready(i2c_dev1)) {
        printk("I2C1 device not ready\n");
        return;
    }

    mpu6050_init(i2c_dev0);
    bmp280_init(i2c_dev1);
}

void i2c_read_data(void) {
    read_mpu6050_data(i2c_dev0);
    read_mlx90614_data(i2c_dev0);
    read_bmp280_data(i2c_dev1);
}
```

## src/i2c.h
```c
#ifndef I2C_H
#define I2C_H

#include <zephyr/device.h>
#include <stdint.h>
#include <stddef.h>

// General I2C read/write functions
int i2c_write_register(const struct device *i2c_dev, uint8_t dev_addr, uint8_t reg_addr, uint8_t data);
int i2c_read_register(const struct device *i2c_dev, uint8_t dev_addr, uint8_t reg_addr, uint8_t *data);
int i2c_read_registers(const struct device *i2c_dev, uint8_t dev_addr, uint8_t reg_addr, uint8_t *data, size_t len);
void i2c_init(void);
void i2c_read_data(void);

#endif
```
